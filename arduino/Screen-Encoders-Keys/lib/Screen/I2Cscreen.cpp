#include "SCREEN.h"


// 'Menu', 16x16px
const unsigned char Menu[] PROGMEM = {
    0x00, 0x00, 0x00, 0x00, 0x00, 0x00, 0x3f, 0xfc, 0x3f, 0xfc, 0x00, 0x00, 0x00, 0x00, 0x3f, 0xfc,
    0x3f, 0xfc, 0x00, 0x00, 0x00, 0x00, 0x3f, 0xfc, 0x3f, 0xfc, 0x00, 0x00, 0x00, 0x00, 0x00, 0x00};
// 'WindowsStart', 16x16px
const unsigned char WindowsStart[] PROGMEM = {
    0x00, 0x00, 0x00, 0x00, 0x00, 0x78, 0x0f, 0x88, 0x33, 0x08, 0x23, 0x08, 0x23, 0x08, 0x3f, 0xf8,
    0x3f, 0xf8, 0x23, 0x08, 0x23, 0x08, 0x33, 0x08, 0x0f, 0x88, 0x00, 0x78, 0x00, 0x00, 0x00, 0x00};
// 'BattleStageGames', 16x16px
const unsigned char BattleStageGames[] PROGMEM = {
    0x00, 0x00, 0x00, 0x00, 0x00, 0x00, 0x00, 0x00, 0x71, 0xcc, 0x4a, 0x12, 0x4a, 0x12, 0x71, 0x10,
    0x48, 0x96, 0x48, 0x52, 0x48, 0x52, 0x73, 0x8c, 0x00, 0x00, 0x00, 0x00, 0x00, 0x00, 0x00, 0x00};
// 'Mute', 16x16px
const unsigned char Mute[] PROGMEM = {
    0x00, 0x00, 0x40, 0x02, 0x20, 0x04, 0x10, 0x08, 0x08, 0x10, 0x04, 0x20, 0x02, 0x40, 0x01, 0x80,
    0x01, 0x80, 0x02, 0x40, 0x04, 0x20, 0x08, 0x10, 0x10, 0x08, 0x20, 0x04, 0x40, 0x02, 0x00, 0x00};
// 'VS_Code', 16x16px
const unsigned char VS_Code[] PROGMEM = {
    0x00, 0x00, 0x00, 0x00, 0x00, 0x30, 0x00, 0x78, 0x20, 0xdc, 0x31, 0x9c, 0x1b, 0x1c, 0x0e, 0x1c,
    0x0e, 0x1c, 0x1b, 0x1c, 0x31, 0x9c, 0x20, 0xdc, 0x00, 0x78, 0x00, 0x30, 0x00, 0x00, 0x00, 0x00};
// 'Pause', 16x16px
const unsigned char Pause[] PROGMEM = {
    0x00, 0x00, 0x00, 0x00, 0x00, 0x00, 0x0e, 0x70, 0x0e, 0x70, 0x0e, 0x70, 0x0e, 0x70, 0x0e, 0x70,
    0x0e, 0x70, 0x0e, 0x70, 0x0e, 0x70, 0x0e, 0x70, 0x0e, 0x70, 0x00, 0x00, 0x00, 0x00, 0x00, 0x00};
// 'Volume', 16x16px
const unsigned char Volume[] PROGMEM = {
    0x00, 0x00, 0x01, 0x00, 0x03, 0x20, 0x07, 0x10, 0x0f, 0x48, 0x1f, 0x24, 0x7f, 0x12, 0x7f, 0x52,
    0x7f, 0x52, 0x7f, 0x12, 0x1f, 0x24, 0x0f, 0x48, 0x07, 0x10, 0x03, 0x20, 0x01, 0x00, 0x00, 0x00};
// 'Spotify', 16x16px
const unsigned char Spotify[] PROGMEM = {
    0x07, 0xe0, 0x18, 0x18, 0x20, 0x04, 0x40, 0x02, 0x47, 0xe2, 0x88, 0x11, 0x90, 0x09, 0x83, 0xc5,
    0x84, 0x21, 0x80, 0x11, 0x81, 0x81, 0x40, 0x42, 0x40, 0x02, 0x20, 0x04, 0x18, 0x18, 0x07, 0xe0};
// 'Outplayed', 16x16px
const unsigned char Outplayed[] PROGMEM = {
    0x01, 0x10, 0x01, 0xb0, 0x01, 0xf0, 0x01, 0x1f, 0x01, 0x0e, 0x3f, 0x98, 0x40, 0x70, 0x80, 0x20,
    0x9d, 0xd0, 0x95, 0x50, 0x9d, 0xd0, 0x80, 0x10, 0x40, 0x20, 0x3f, 0xc0, 0x2a, 0x80, 0x3f, 0x80};
// 'Minecraft', 16x16px
const unsigned char Minecraft[] PROGMEM = {
    0xff, 0xff, 0x80, 0x01, 0x80, 0x01, 0x9e, 0x79, 0x9e, 0x79, 0x9e, 0x79, 0x9e, 0x79, 0x80, 0x01,
    0x80, 0x01, 0x83, 0xc1, 0x9f, 0xf9, 0x9f, 0xf9, 0x98, 0x19, 0x80, 0x01, 0x80, 0x01, 0xff, 0xff};
// 'Folder', 16x16px
const unsigned char Folder[] PROGMEM = {
    0x00, 0x00, 0x00, 0x00, 0xfe, 0x00, 0x81, 0x00, 0x80, 0xff, 0x80, 0x01, 0x80, 0x01, 0x80, 0x01,
    0x80, 0x01, 0x8f, 0xf1, 0x8f, 0xf1, 0x8c, 0x31, 0x8c, 0x31, 0xff, 0xff, 0x0c, 0x30, 0x00, 0x00};
// 'Microfoon', 16x16px
const unsigned char Microfoon[] PROGMEM = {
    0x00, 0x00, 0x01, 0x80, 0x03, 0xc0, 0x03, 0xc0, 0x0b, 0xd0, 0x0b, 0xd0, 0x0b, 0xd0, 0x0b, 0xd0,
    0x0b, 0xd0, 0x09, 0x90, 0x04, 0x20, 0x03, 0xc0, 0x01, 0x80, 0x01, 0x80, 0x1f, 0xf8, 0x00, 0x00};
// 'Start', 16x16px
const unsigned char Start[] PROGMEM = {
    0x00, 0x00, 0x00, 0x00, 0x04, 0x00, 0x06, 0x00, 0x07, 0x00, 0x07, 0x80, 0x07, 0xc0, 0x07, 0xe0,
    0x07, 0xe0, 0x07, 0xc0, 0x07, 0x80, 0x07, 0x00, 0x06, 0x00, 0x04, 0x00, 0x00, 0x00, 0x00, 0x00};
// 'Discord', 16x16px
const unsigned char Discord[] PROGMEM = {
    0x00, 0x00, 0x1e, 0x78, 0x22, 0x44, 0x4f, 0xf2, 0x90, 0x09, 0x80, 0x01, 0x80, 0x01, 0x84, 0x21,
    0x8a, 0x51, 0x8a, 0x51, 0x84, 0x21, 0x90, 0x09, 0x48, 0x12, 0x27, 0xe4, 0x18, 0x18, 0x00, 0x00};
// 'LightRoom', 16x16px
const unsigned char LightRoom[] PROGMEM = {
    0xff, 0xff, 0x80, 0x01, 0x80, 0x01, 0x90, 0x01, 0x90, 0x01, 0x90, 0x59, 0x90, 0x65, 0x90, 0x41,
    0x90, 0x41, 0x90, 0x41, 0x90, 0x41, 0x90, 0x41, 0x9e, 0x41, 0x80, 0x01, 0x80, 0x01, 0xff, 0xff};
// 'MasterVolume', 16x16px
const unsigned char MasterVolume[] PROGMEM = {
    0x00, 0x00, 0x00, 0x00, 0x00, 0x00, 0x04, 0x00, 0x0c, 0x82, 0x1c, 0xc6, 0x7c, 0xaa, 0x7c, 0xaa,
    0x7c, 0x92, 0x7c, 0x82, 0x1c, 0x82, 0x0c, 0x82, 0x04, 0x00, 0x00, 0x00, 0x00, 0x00, 0x00, 0x00};

// 'item_sel_outline', 128x21px
const unsigned char item_sel_outline[] PROGMEM = {
    0x1f, 0xff, 0xff, 0xff, 0xff, 0xff, 0xff, 0xff, 0xff, 0xff, 0xff, 0xff, 0xff, 0xff, 0xff, 0xc0,
    0x20, 0x00, 0x00, 0x00, 0x00, 0x00, 0x00, 0x00, 0x00, 0x00, 0x00, 0x00, 0x00, 0x00, 0x00, 0x20,
    0x40, 0x00, 0x00, 0x00, 0x00, 0x00, 0x00, 0x00, 0x00, 0x00, 0x00, 0x00, 0x00, 0x00, 0x00, 0x30,
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    0x1f, 0xff, 0xff, 0xff, 0xff, 0xff, 0xff, 0xff, 0xff, 0xff, 0xff, 0xff, 0xff, 0xff, 0xff, 0xc0};

//// END OF BITMAP DEFINITIONS

// Bitmap list
const unsigned char *bitmapList[] = {
    Menu,
    WindowsStart,
    BattleStageGames,
    Mute,
    VS_Code,
    Pause,
    Volume,
    Spotify,
    Outplayed,
    Minecraft,
    Folder,
    Microfoon,
    Start,
    Discord,
    LightRoom,
    MasterVolume,
    item_sel_outline
};

Screen::Screen(Adafruit_SSD1305 &disp) : display(disp), menuList(nullptr) {}  // Initialize menuList to nullptr

void Screen::setup() {
    if (!display.begin(SSD1305_I2C_ADDRESS, 0x03)) {
        Serial.println(F("SSD1305 allocation failed"));
        for (;;);
    }
    display.clearDisplay();
    display.setTextSize(1);
    display.setTextColor(WHITE);
}

void Screen::loop(){
    // Activate the correct page;
    display.clearDisplay();
    switch (current_page){
        case 0:
            updateMenuDisplay();
            PAGE_ControlMenu();
            break;
        case 1:
            PAGE_VolumeControle();
            break;
        case 2:
            PAGE_KeyVolumeControl(GamingPage, Screen.ActiveVolumeValues);
            break;
        default:
            break;
    }
    display.display();
}


void setEncoderValues(int *encodervalues, bools *encoderbuttons){
    int length = sizeof(EncoderValues) / sizeof(EncoderValues[0]);
    for (int i = 0; i < length; i++)
    {
        EncoderValues
    }
    
    int EncoderValues[2]
}

void PAGE_ControlMenu()
{
  // Check if the UP button is pressed
  int encoder1Difference = EncoderValues[1] - EncoderPrevieusValues[1];
  int encoder2Difference = EncoderValues[2] - EncoderPrevieusValues[2];
  if (encoder1Difference > 0)
  {
    item_selected++;
    if (item_selected >= ITEMS_PER_PAGE)
    {
      item_selected = 0;
    }
    updateMenuDisplay();
    delay(200); // Debounce delay
  }

  // Check if the DOWN button is pressed
  if (encoder1Difference < 0)
  {
    item_selected--;
    if (item_selected < 0)
    {
      item_selected = ITEMS_PER_PAGE - 1;
    }
    updateMenuDisplay();
    delay(200); // Debounce delay
  }
  if (digitalRead(BUTTON_SELECT_PIN) == LOW)
  {
    String selectedOption = menuList[item_selected].name;
    Serial.print("SelectedOption: ");
    Serial.println(selectedOption);
    if (selectedOption == "Volume")
    {
      current_page = 1;
    }
    if (selectedOption == "BattleStageGames")
    {
      current_page = 2;
    }
  }
  EncoderPrevieusValues[1] = EncoderValues[1];
  EncoderPrevieusValues[1] = EncoderValues[1];
}


void Screen::displayMenu() {
    // Check if menuList is valid
    if (menuList == nullptr) {
        Serial.println("Menu list not initialized.");
        return;
    }

    // Calculate previous and next item indices
    int numItems = ITEMS_PER_PAGE; // Assuming ITEMS_PER_PAGE equals the number of items to show
    int item_sel_previous = (item_selected - 1 + numItems) % numItems;
    int item_sel_next = (item_selected + 1) % numItems;

    // Draw the screen
    display.clearDisplay();

    // Draw the selected item background
    display.drawBitmap(0, 22, item_sel_outline, 128, 21, WHITE);

    // Draw previous item as icon + label
    display.setCursor(25, 8);
    display.print(menuList[item_sel_previous].name);
    display.drawBitmap(5, 3, menuList[item_sel_previous].icon, 16, 16, WHITE);

    // Draw selected item as icon + label in bold font
    // If you want to use a different font, you would set it here
    display.setCursor(25, 28);
    display.setTextSize(2);  // Larger text size for emphasis
    display.print(menuList[item_selected].name);
    display.drawBitmap(5, 24, menuList[item_selected].icon, 16, 16, WHITE);

    // Draw next item as icon + label
    display.setCursor(25, 51);
    display.setTextSize(1);  // Reset text size to normal
    display.print(menuList[item_sel_next].name);
    display.drawBitmap(5, 45, menuList[item_sel_next].icon, 16, 16, WHITE);

    // Update the display
    display.display();
}

void Screen::setMenuList(IconItem *ListItems) {
    menuList = ListItems;
}

void Screen::drawBitmap(const unsigned char *bitmap, uint8_t x, uint8_t y) {
    display.drawBitmap(x, y, bitmap, 16, 16, WHITE);  // Set color to WHITE for visibility
}